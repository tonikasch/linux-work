## Documentation/devicetree/bindings/i2c/i2c-sunxi.txt
```
Allwinner SoC I2C controller

Required properties:
- compatible : Should be "allwinner,sun4i-i2c".
- reg: Should contain register location and length.
- interrupts: Should contain interrupt.
- clocks : The parent clock feeding the I2C controller.

Recommended properties:
- clock-frequency : desired I2C bus clock frequency in Hz.

Example:
i2c0: i2c@01c2ac00 {
	compatible = "allwinner,sun4i-i2c";
	reg = <0x01c2ac00 0x400>;
	interrupts = <7>;
	clocks = <&apb1_gates 0>;
	clock-frequency = <100000>;
};
```

## Documentation/devicetree/bindings/phy/sun4i-usb-phy.txt
```
Allwinner sun4i USB PHY
-----------------------

Required properties:
- compatible : should be one of "allwinner,sun4i-a10-usb-phy",
  "allwinner,sun5i-a13-usb-phy" or "allwinner,sun7i-a20-usb-phy"
- reg : 2 or 3 register offset + length pairs, 1 phy base reg pair +
  1 pair for the pmu-irq register of each hcd
- #phy-cells : from the generic phy bindings, must be 1

Optional properties:
- clocks : phandle + clock specifier for the phy clock
- clock-names : "usb_phy"
- resets : a list of phandle + reset specifier pairs
- reset-names : "usb0_reset", "usb1_reset", and / or "usb2_reset"

Example:
	usbphy: phy@0x01c13400 {
		#phy-cells = <1>;
		compatible = "allwinner,sun4i-a10-usb-phy";
		reg = <0x01c13400 0x10 0x01c14800 0x4 0x01c1c800 0x4>;
		clocks = <&usb_clk 8>;
		clock-names = "usb_phy";
		resets = <&usb_clk 1>, <&usb_clk 2>;
		reset-names = "usb1_reset", "usb2_reset";
	};
```

## Documentation/devicetree/bindings/usb/mmio-ehci.txt
```
Generic MMIO EHCI controller

Required properties:
- compatible : "via,vt8500-ehci", "wm,prizm-ehci", or "mmio-ehci"
- reg : ehci controller register range (address and length)
- interrupts : ehci controller interrupt

Optional properties:
- clocks : a list of phandle + clock specifier pairs
- phys : phandle + phy specifier pair
- phy-names : "usb"

Example:

	ehci@d8007900 {
		compatible = "via,vt8500-ehci", "mmio-ehci";
		reg = <0xd8007900 0x200>;
		interrupts = <43>;
		clocks = <&usb_clk 6>, <&ahb_gates 2>;
		phys = <&usbphy 1>;
		phy-names = "usb";
	};
```

## Documentation/devicetree/bindings/usb/mmio-ohci.txt
```
Generic MMIO OHCI controller

Required properties:
- compatible : "mmio-ohci"
- reg : ohci controller register range (address and length)
- interrupts : ohci controller interrupt

Optional properties:
- clocks : a list of phandle + clock specifier pairs
- phys : phandle + phy specifier pair
- phy-names : "usb"

Example:

	ohci0: ohci@0x01c14400 {
		compatible = "mmio-ohci";
		reg = <0x01c14400 0x100>;
		interrupts = <64>;
		clocks = <&usb_clk 6>, <&ahb_gates 2>;
		phys = <&usbphy 1>;
		phy-names = "usb";
	};
```

## Documentation/devicetree/bindings/usb/platform-ehci.txt
```
Generic Platform EHCI controller

Required properties:
- compatible : "via,vt8500-ehci" or "wm,prizm-ehci"
- reg : ehci controller register range (address and length)
- interrupts : ehci controller interrupt

Optional properties:
- clocks : a list of phandle + clock specifier pairs, one for each entry
   in clock-names.
- clock-names : "clk0", "clk1", ...
- phys : phy
- phy-names : "phy0"

Example:

	ehci@d8007900 {
		compatible = "via,vt8500-ehci";
		reg = <0xd8007900 0x200>;
		interrupts = <43>;
		clocks = <&usb_clk 6>, <&ahb_gates 2>;
		clock-names = "clk0", "clk1";
		phys = <&usbphy 1>;
		phy-names = "phy0";
	};
```

## Documentation/devicetree/bindings/usb/platform-ohci.txt
```
Generic Platform OHCI controller

Required properties:
- compatible : "allwinner,sun4i-ohci"
- reg : ohci controller register range (address and length)
- interrupts : ohci controller interrupt

Optional properties:
- clocks : a list of phandle + clock specifier pairs, one for each entry
   in clock-names.
- clock-names : "clk0", "clk1", ...
- phys : phy
- phy-names : "phy0"

Example:

	ohci0: ohci@0x01c14400 {
		compatible = "allwinner,sun4i-ohci";
		reg = <0x01c14400 0x100>;
		interrupts = <64>;
		clocks = <&usb_clk 6>, <&ahb_gates 2>;
		clock-names = "clk0", "clk1";
		phys = <&usbphy 1>;
		phy-names = "phy0";
	};
```

## drivers/net/wireless/rtl8188eu/Kconfig
```kconfig
config RTL8188EU
	tristate "Realtek 8188EU from Larry Finger git tree"
	depends on USB
	  select WIRELESS_EXT
	  select WEXT_PRIV
	  select CFG80211
          select MAC80211
	---help---
	  Realtek driver from git://github.com/lwfinger/rtl8188eu
```
